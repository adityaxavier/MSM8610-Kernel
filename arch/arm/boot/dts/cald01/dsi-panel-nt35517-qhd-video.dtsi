/* Copyright (c) 2013, The Linux Foundation. All rights reserved.
 *
 * This program is free software; you can redistribute it and/or modify
 * it under the terms of the GNU General Public License version 2 and
 * only version 2 as published by the Free Software Foundation.
 *
 * This program is distributed in the hope that it will be useful,
 * but WITHOUT ANY WARRANTY; without even the implied warranty of
 * MERCHANTABILITY or FITNESS FOR A PARTICULAR PURPOSE.  See the
 * GNU General Public License for more details.
 */

/*---------------------------------------------------------------------------
 * This file is autogenerated file using gcdb parser. Please do not edit it.
 * Update input XML file to add a new entry or update variable in this file
 * VERSION = "1.0"
 *---------------------------------------------------------------------------*/
&mdss_mdp {
	dsi_nt35517_qhd_vid: qcom,mdss_dsi_nt35517_qhd_video {
		qcom,mdss-dsi-panel-name = "NT35517 QHD video mode dsi panel";
		qcom,mdss-dsi-panel-controller = <&mdss_dsi0>;
		qcom,mdss-dsi-panel-type = "dsi_video_mode";
		qcom,mdss-dsi-panel-destination = "display_1";
		qcom,mdss-dsi-panel-framerate = <60>;
		qcom,mdss-dsi-virtual-channel-id = <0>;
		qcom,mdss-dsi-stream = <0>;
		qcom,mdss-dsi-panel-width = <540>;
		qcom,mdss-dsi-panel-height = <960>;
		qcom,mdss-dsi-h-front-porch = <100>;
		qcom,mdss-dsi-h-back-porch = <100>;
		qcom,mdss-dsi-h-pulse-width = <8>;
		qcom,mdss-dsi-h-sync-skew = <0>;
		qcom,mdss-dsi-v-back-porch = <20>;
		qcom,mdss-dsi-v-front-porch = <20>;
		qcom,mdss-dsi-v-pulse-width = <1>;
		qcom,mdss-dsi-h-left-border = <0>;
		qcom,mdss-dsi-h-right-border = <0>;
		qcom,mdss-dsi-v-top-border = <0>;
		qcom,mdss-dsi-v-bottom-border = <0>;
		qcom,mdss-dsi-bpp = <24>;
		qcom,mdss-dsi-color-order = <0>;
		qcom,mdss-dsi-underflow-color = <0xff>;
		qcom,mdss-dsi-border-color = <0>;
		qcom,mdss-dsi-on-command = [
					29 01 00 00 0A 00 05 FF AA 55 25 01
					29 01 00 00 0A 00 02 6F 14
					29 01 00 00 0A 00 04 F2 00 00 00 
					29 01 00 00 00 00 06 F0 55 AA 52 08 00
					29 01 00 00 00 00 04 B1 FC 00 00
					29 01 00 00 00 00 05 B8 01 02 02 02
					29 01 00 00 00 00 04 BC 00 00 00
					29 01 00 00 00 00 07 C9 53 06 0D 1A 17 00
					29 01 00 00 00 00 06 F0 55 AA 52 08 01
					29 01 00 00 00 00 04 B0 05 05 05
					29 01 00 00 00 00 04 B1 05 05 05
					29 01 00 00 00 00 04 B2 01 01 01
					29 01 00 00 00 00 04 B3 0D 0D 0D
					29 01 00 00 00 00 04 B4 09 09 09
					29 01 00 00 00 00 04 B6 44 44 44
					29 01 00 00 00 00 04 B7 44 44 44
					29 01 00 00 00 00 04 B8 13 13 13
					29 01 00 00 00 00 04 B9 24 24 24
					29 01 00 00 00 00 04 BA 24 24 24
					29 01 00 00 00 00 04 BC 00 80 00
					29 01 00 00 00 00 04 BD 00 7C 00
					29 01 00 00 00 00 02 BE 50
					29 01 00 00 00 00 03 C0 04 00
					29 01 00 00 00 00 02 CA 00
					29 01 00 00 00 00 02 CF 04
					29 01 00 00 00 00 05 D0 06 10 0D 0F
					29 01 00 00 00 00 11 D1 00 16 00 28 00 47 00 5F 00 72 00 96 00 B1 00 E0
					29 01 00 00 00 00 11 D2 01 02 01 3B 01 6B 01 B8 01 F4 01 F6 02 2E 02 72
					29 01 00 00 00 00 11 D3 02 98 02 D0 02 F1 03 26 03 3F 03 66 03 7E 03 8C
					29 01 00 00 00 00 05 D4 03 C4 03 FF
					29 01 00 00 00 00 11 D5 00 16 00 28 00 47 00 5F 00 72 00 96 00 B1 00 E0
					29 01 00 00 00 00 11 D6 01 02 01 3B 01 6B 01 B8 01 F4 01 F6 02 2E 02 72
					29 01 00 00 00 00 11 D7 02 98 02 D0 02 F1 03 26 03 3F 03 66 03 7E 03 8C
					29 01 00 00 00 00 05 D8 03 C4 03 FF
					29 01 00 00 00 00 11 D9 00 16 00 28 00 47 00 5F 00 72 00 96 00 B1 00 E0
					29 01 00 00 00 00 11 DD 01 02 01 3B 01 6B 01 B8 01 F4 01 F6 02 2E 02 72
					29 01 00 00 00 00 11 DE 02 98 02 D0 02 F1 03 26 03 3F 03 66 03 7E 03 8C
					29 01 00 00 00 00 05 DF 03 C4 03 FF
					29 01 00 00 00 00 11 E0 00 16 00 28 00 47 00 5F 00 72 00 96 00 B1 00 E0
					29 01 00 00 00 00 11 E1 01 02 01 3B 01 6B 01 B8 01 F4 01 F6 02 2E 02 72
					29 01 00 00 00 00 11 E2 02 98 02 D0 02 F1 03 26 03 3F 03 66 03 7E 03 8C
					29 01 00 00 00 00 05 E3 03 C4 03 FF
					29 01 00 00 00 00 11 E4 00 16 00 28 00 47 00 5F 00 72 00 96 00 B1 00 E0
					29 01 00 00 00 00 11 E5 01 02 01 3B 01 6B 01 B8 01 F4 01 F6 02 2E 02 72
					29 01 00 00 00 00 11 E6 02 98 02 D0 02 F1 03 26 03 3F 03 66 03 7E 03 8C
					29 01 00 00 00 00 05 E7 03 C4 03 FF
					29 01 00 00 00 00 11 E8 00 16 00 28 00 47 00 5F 00 72 00 96 00 B1 00 E0
					29 01 00 00 00 00 11 E9 01 02 01 3B 01 6B 01 B8 01 F4 01 F6 02 2E 02 72
					29 01 00 00 00 00 11 EA 02 98 02 D0 02 F1 03 26 03 3F 03 66 03 7E 03 8C
					29 01 00 00 00 00 05 EB 03 C4 03 FF
					29 01 00 00 00 00 02 35 00
					05 01 00 00 78 00 02 11 00
					05 01 00 00 32 00 02 29 00
					];
		qcom,mdss-dsi-off-command = [05 01 00 00 32 00 02 28 00
					05 01 00 00 78 00 02 10 00];
		qcom,mdss-dsi-on-command-state = "dsi_lp_mode";
		qcom,mdss-dsi-off-command-state = "dsi_lp_mode";
		qcom,mdss-dsi-h-sync-pulse = <1>;
		qcom,mdss-dsi-traffic-mode = "burst_mode";
		qcom,mdss-dsi-lane-map = "lane_map_3012";
		qcom,mdss-dsi-bllp-eof-power-mode;
		qcom,mdss-dsi-bllp-power-mode;
		qcom,mdss-dsi-lane-0-state;
		qcom,mdss-dsi-lane-1-state;
		qcom,mdss-dsi-panel-timings = [7d 25 1d 00 37 33 22 27 1e 03 04 00];
		qcom,mdss-dsi-t-clk-post = <0x04>;
		qcom,mdss-dsi-t-clk-pre = <0x1b>;
		qcom,mdss-dsi-bl-min-level = <35>;
		qcom,mdss-dsi-bl-max-level = <255>;
		qcom,mdss-dsi-dma-trigger = "trigger_sw";
		qcom,mdss-dsi-mdp-trigger = "none";
		qcom,mdss-dsi-bl-pmic-control-type = "bl_ctrl_wled";
		qcom,mdss-dsi-reset-sequence = <1 20>, <0 20>, <1 20>;

	};
};
